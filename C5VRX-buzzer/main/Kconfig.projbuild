## C5VRX-buzzer/main/Kconfig.projbuild
```kconfig
menu "C5VRX buzzer"

config C5VRX_BUZZER_SWEEP
    bool "Sweep the 5 GHz band continuously"
    default y
    help
        Tune through the standard 5 GHz Wi-Fi channels (36..64, 100..144,
        149..177, i.e. 5180..5885 MHz in 20 MHz steps) over and over, measure
        the carrier power on each and drive the buzzer from the strongest
        channel. Disable to listen on C5VRX_BUZZER_WIFI_CHANNEL only.

config C5VRX_BUZZER_SWEEP_MIN_MHZ
    int "Sweep start (MHz)"
    depends on C5VRX_BUZZER_SWEEP
    range 5170 5925
    default 5180
    help
        Lowest channel centre to include. FPV bands live in 5645..5945 MHz;
        5645 skips the Wi-Fi-only lower half and doubles the sweep rate.

config C5VRX_BUZZER_SWEEP_MAX_MHZ
    int "Sweep end (MHz)"
    depends on C5VRX_BUZZER_SWEEP
    range 5170 5925
    default 5925
    help
        Highest channel centre to include. 5885 (channel 177) is the top of
        the standard Wi-Fi grid; 5905 and 5925 (channels 181, 185, FPV bands
        E8 / R8) are offered to the driver as well. Channels the driver
        rejects are reported at boot and skipped.

config C5VRX_BUZZER_SWEEP_STEP_MHZ
    int "Sweep step (MHz)"
    depends on C5VRX_BUZZER_SWEEP
    range 20 40
    default 20
    help
        20 visits every standard channel (the ~20 MHz analog passband then
        covers the band without gaps), 40 visits every other channel for a
        faster sweep.

config C5VRX_BUZZER_WIFI_CHANNEL
    int "5 GHz Wi-Fi channel when not sweeping"
    range 36 177
    default 169
    help
        The receiver starts on this channel and stays on it when the sweep
        is disabled or when every sweep channel is rejected. Centre frequency
        is 5000 + 5 * channel MHz: FPV Raceband R6 5843 MHz -> 169 (5845 MHz),
        band A1 5865 MHz -> 173. C5VRX itself was proven on 173.

config C5VRX_BUZZER_REJECT_NOISE
    bool "Ignore carriers with a noise-like envelope (pure-noise jammers)"
    default y
    help
        An FM video carrier has a constant envelope; Gaussian noise does
        not (power variance / mean^2 close to 1). Channels that fail this
        test never drive the buzzer. Applied only to channels strong enough
        to judge (minimum window power >= 6, about 6 dB above the noise).

config C5VRX_BUZZER_REQUIRE_SYNC
    bool "Require television line sync in the demodulated signal"
    default y
    help
        FM-demodulate the captured I/Q and require the autocorrelation at
        one video line (64.0 us PAL / 63.6 us NTSC) to exceed 0.25. Rejects
        unmodulated (CW), noise-modulated and swept jammers, and also a
        transmitter with no camera attached. Costs about 2 ms per channel
        above the noise. Applied only to channels strong enough to judge.

config C5VRX_BUZZER_GPIO
    int "Buzzer GPIO"
    range 0 28
    default 25
    help
        GPIO that drives the passive buzzer with an LEDC PWM tone.
        25 is pad D2 of the Seeed Studio XIAO ESP32-C5; 3 is its MTDI pad.
        It must not be one of the MODEM_DIAG lane GPIOs 1, 0, 23, 7, 10, 5,
        24 and 4 (see rf.c), which toggle at 40 MHz while receiving.

endmenu
```

## experiments/video-link/uart/components/video_link_uart/Kconfig
```kconfig
menu "C5VRX video link (UART)"

config C5VRX_LINK_CHANNEL
    int "FPV channel at boot (band x 8 + channel - 1)"
    range 0 47
    default 5
    help
        Index into the receiver's channel table: bands R, A, B, E, F, L in
        that order, 8 channels each. 5 = R6 (5843 MHz), 8 = A1 (5865 MHz).
        A link build always uses the wide (BW40) analog filter.

config C5VRX_LINK_STREAM
    bool "Stream frames over UART from boot"
    default y
    help
        Grab frames continuously and send them to a display board (LilyGo
        T-Embed) over UART, protocol in protocol/link_proto.h. Console keys:
        'S' streaming on/off, 'P' picture mode, 'N' channel scan, 'M'
        horizontal smoothing.

config C5VRX_LINK_DEBUG
    bool "Debug output and dump tools"
    default n
    help
        Adds what is only needed at the desk: the [STREAM] statistics line
        every second and [LOST] traces, and the console dumps 'v' (raw I/Q
        plus BitScrambler loopback demodulation, tools/link_dump.py) and 'g'
        (one frame, tools/link_frame.py). Off in the final build: nothing is
        printed while streaming, and the loopback BitScrambler and its 24 KB
        of DMA buffers are not set up. sdkconfig.debug.defaults (PlatformIO
        environment xiao_c5_link_debug) turns it on.

config C5VRX_LINK_PICTURE_MODE
    int "Picture mode at boot (0 auto, 1 fine, 2 raw)"
    range 0 2
    default 0
    help
        0 auto: rows coded near-losslessly, the tolerance chosen per frame so
        that a frame fits the link in the time the grabber needs for it (up
        to 25 fps PAL at 4 Mbaud). 1 fine: tolerance +/- 1 level, fewer fps.
        2 raw: 8-bit rows, about 10 fps at 4 Mbaud. The display board can
        switch modes at run time.

config C5VRX_LINK_UART_TX_GPIO
    int "UART TX GPIO"
    default 11
    help
        11 is XIAO pad D6. Connect it to the display board's RX (T-Embed
        UART connector RXD, GPIO44).

config C5VRX_LINK_UART_RX_GPIO
    int "UART RX GPIO"
    default 12
    help
        12 is XIAO pad D7 (display board TX, T-Embed GPIO43): commands from
        the display (scan, channel steps, picture mode).

config C5VRX_LINK_UART_BAUD
    int "UART baud rate"
    default 4000000
    help
        4000000 is proven on the bench. 5000000 is the limit of both UARTs
        (ESP32-C5 and ESP32-S3) and gives the auto picture mode 25 % more
        bytes per frame; the display firmware follows either rate.

endmenu
```

## main/Kconfig.projbuild
```kconfig
menu "C5VRX diagnostic probes"
    config C5VRX_PHY_PHASE_TAP_PROBE
        bool "Capture bounded MODEM_DIAG lane traces at boot, then start video"
        default n
        help
            Capture all 32 MODEM_DIAG lanes under four previously tested
            selector states on the production IQ GPIOs before video starts.
            Restore all selector registers and the normal IQ routing after
            capture. CPU snapshots are asynchronous and cannot alone prove a
            40 MS/s phase tap. This option is for an experimental PR build.

    config C5VRX_BS_RELATIVE_WORKER_PROBE
        bool "Run Counter-A relative-mux loopback oracle before starting video"
        default n
        help
            Run a finite two-bundle BitScrambler loopback test at boot and
            print BS_REL_WORKER PASS/FAIL, then start the normal RF/video path.

    config C5VRX_BS_RELATIVE_MIDDLE_PROBE
        bool "Run alternating middle/endpoint relative-mux loopback probe before starting video"
        default y
        help
            Run a finite two-bundle BitScrambler loopback test at boot to prove
            alternating middle-sample and endpoint-sample Phase5 extraction,
            then start the normal RF/video path.

    config C5VRX_BS_ADDCTIA_PROBE
        bool "Run Counter-A ADDCTIA hardware subtraction loopback probe before starting video"
        default y
        help
            Run a finite BitScrambler loopback test at boot to prove
            single-cycle Counter-A hardware subtraction (ADDCTIAL + LDCTIAL)
            and compact 32-entry DAC lookup for Phase5-360, then start the
            normal RF/video path.
endmenu

menu "C5VRX experimental video demodulators"
    config C5VRX_PHASE8_HR_LIVE_TEST
        bool "Run full-range adjacent Phase8 on live 6BIT@40 video"
        default y
        help
            Experimental full signed Phase8 delta mapping plus Direct Gain V3.
            Maps -128..+127 phase bins across the 64 DAC levels and forces
            6BIT@40 output. A phase step crossing +/-180 degrees still aliases.

    config C5VRX_PHASE5_360_LIVE
        bool "Use Phase5-360 research program (Golden DAC output only)"
        default y
        help
            Load the two-bundle middle-sample routing experiment. Both worker
            branches currently output the same Golden DAC bytes. No adjacent
            winding correction is active in the live firmware.

    config C5VRX_RELATIVE_GOLDEN_LIVE
        bool "Use relative-mux Golden in the live 6-bit video path"
        default n
        help
            Replace only the 6-bit Golden BitScrambler program with the
            two-bundle Counter-A relative-mux oracle. Intended for live
            equivalence testing; no winding correction is performed.
endmenu

config C5VRX_DIRECT_GAIN_V3_EXPERIMENT
    bool "Run predictive Direct Gain V3 on the default automatic RX profile"
    default y
    help
        Experimental issue #107 build. The existing live demodulator stays
        selected, while V3 alone owns automatic RF gain on the default
        profile. Hardware gain and video validation is required before merge.

menu "C5VRX RF front end"
    config C5VRX_PHY_11P
        bool "Apply the vendor 802.11p receive setup, phy_11p_set(1, 0)"
        default y
        help
            After RF start and after every channel or frequency-offset change,
            call the ESP32-C5 PHY library's phy_11p_set(1, 0), its setup for
            802.11p (the 5.9 GHz vehicular Wi-Fi band). It was reported to
            improve reception from 5.75 to 5.99 GHz (observation credited to
            SushiDude, @Ready4Sushi on X). C5VRX has no controlled
            measurement of it yet: that range is the report, not a known
            limit, and the effect below 5.75 GHz is unknown. It writes four
            baseband registers and analog I2C block 0x67 registers 6..13; the
            PHY library replays it on every channel set. Turn it off for an
            A/B comparison.
endmenu
```
